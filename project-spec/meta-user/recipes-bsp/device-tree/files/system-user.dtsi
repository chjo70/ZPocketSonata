/include/ "system-conf.dtsi"
/ {
		chosen	{
			bootargs = "earlycon clk_ignore_unused uio_pdrv_genirq.of_id=generic-uio";
			stdout-path = "serial0:115200n8";
		};
};

&single_dma_if_axi_dma_0 {
	compatible = "generic-uio";
};

&sdhci1 {
	status = "okay";
	pinctrl-names = "default";
	no-1-8-v;
	disable-wp;
	xlnx,mio_bank = <1>;
};